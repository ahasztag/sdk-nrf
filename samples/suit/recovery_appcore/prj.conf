## CMakeLists.txt
```
#
# Copyright (c) 2024 Nordic Semiconductor ASA
#
# SPDX-License-Identifier: LicenseRef-Nordic-5-Clause
#

cmake_minimum_required(VERSION 3.20.0)

find_package(Zephyr REQUIRED HINTS $ENV{ZEPHYR_BASE})

project(suit_recovery_app)

target_sources(app PRIVATE src/main.c)
```

## Kconfig
```
#
# Copyright (c) 2023 Nordic Semiconductor ASA
#
# SPDX-License-Identifier: LicenseRef-Nordic-5-Clause
#

config SUIT_MPI_APP_RECOVERY_VENDOR_NAME
	string "Vendor name to generate vendor UUID"
	default "nordicsemi.com"

config SUIT_MPI_APP_RECOVERY_CLASS_NAME
	string "Vendor name to generate class UUID"
	default "nRF54H20_app_recovery"

source "Kconfig.zephyr"
```

## sysbuild.conf
```
#
# Copyright (c) 2024 Nordic Semiconductor ASA
#
# SPDX-License-Identifier: LicenseRef-Nordic-5-Clause
#

SB_CONFIG_SUIT_ENVELOPE=y

SB_CONFIG_SUIT_ENVELOPE_ROOT_TEMPLATE_FILENAME="app_recovery_envelope.yaml.jinja2"

# As the root envelope for the recovery firmware is directly responsible
# for the application domain image (not only for managing other manifests)
# it is more convenient to use the name "application" for the artifacts.
SB_CONFIG_SUIT_ENVELOPE_ROOT_ARTIFACT_NAME="application"
```

## prj.conf
```kconfig
#
# Copyright (c) 2024 Nordic Semiconductor ASA
#
# SPDX-License-Identifier: LicenseRef-Nordic-5-Clause
#

#
# Kconfigs necessary to build the application as a recovery application

CONFIG_SUIT_RECOVERY=y
CONFIG_SUIT_MPI_GENERATE=n
CONFIG_SUIT_ENVELOPE_OUTPUT_MPI_MERGE=n
CONFIG_NRF_REGTOOL_GENERATE_UICR=n
CONFIG_NRF_REGTOOL_GENERATE_BICR=n

############

# Kconfigs needed to provide the recovery application functionality

CONFIG_ZCBOR=y
CONFIG_ZCBOR_CANONICAL=y

CONFIG_SUIT=y
CONFIG_FLASH=y


########

# Disable unneeded drivers, peripherals and features to optimize for size
CONFIG_SIZE_OPTIMIZATIONS=y

CONFIG_I2C=n
CONFIG_WATCHDOG=n
CONFIG_SPI=n
CONFIG_GPIO=n
CONFIG_SERIAL=y

CONFIG_FPU=n

CONFIG_BOOT_BANNER=n
CONFIG_NCS_BOOT_BANNER=n
CONFIG_BOOT_DELAY=0

CONFIG_CONSOLE=y
CONFIG_STDOUT_CONSOLE=n
CONFIG_PRINTK=y
CONFIG_EARLY_CONSOLE=n

CONFIG_ARM_MPU=n

CONFIG_TIMESLICING=n
CONFIG_MINIMAL_LIBC_MALLOC=n
CONFIG_LOG=n
CONFIG_ASSERT=n

CONFIG_SSF_ECHO_SERVICE_ENABLED=n
CONFIG_SSF_RESET_EVT_SERVICE_ENABLED=n
```

## boards/nrf54h20dk_nrf54h20_cpuapp.overlay
```dts
/*
 * Copyright (c) 2024 Nordic Semiconductor ASA
 *
 * SPDX-License-Identifier: LicenseRef-Nordic-5-Clause
 */

 / {
	chosen {
		zephyr,code-partition = &cpuapp_recovery_partition;
		nrf,tz-secure-image = &cpuapp_recovery_partition;
	};
};

&cpusec_cpuapp_ipc {
	status = "okay";
};

&cpusec_bellboard {
	status = "okay";
};
```

## src/main.c
```c
/*
 * Copyright (c) 2024 Nordic Semiconductor ASA
 *
 * SPDX-License-Identifier: LicenseRef-Nordic-5-Clause
 */

#include <zephyr/kernel.h>

volatile int test = 0;

int main(void)
{
	while (true)
	{
		test++;
		printk("test: %d\n", test);
	}
	return 0;
}
```
